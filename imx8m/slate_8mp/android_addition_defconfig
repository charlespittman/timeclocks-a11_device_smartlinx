## imx8m/slate_8mp/android_addition_defconfig
```kconfig
CONFIG_LIBNVDIMM=y
CONFIG_OF_PMEM=y
CONFIG_BT_HCIBTSDIO=m
CONFIG_BT_HCIUART_MRVL=y
CONFIG_BT_MRVL=y
CONFIG_BT_MRVL_SDIO=y
CONFIG_MWIFIEX=m
CONFIG_MWIFIEX_SDIO=m
CONFIG_MWIFIEX_PCIE=m
CONFIG_MWIFIEX_USB=m
CONFIG_SND_SOC_WM8904=y
CONFIG_DEBUG_FS=y
CONFIG_LOGO_SLX_CLUT224=y
```
